## board/rayallen/pod-g3/Kconfig
```kconfig
if TARGET_POD_G3

config SYS_BOARD
	default "pod-g3"

config SYS_VENDOR
	default "rayallen"

config SYS_SOC
	default "at91"

config SYS_CONFIG_NAME
	default "pod-g3"

endif
```
